## examples/esp32/main/Kconfig.projbuild
```kconfig
menu "Peer Example Configuration"

    config EXAMPLE_ENABLE_CAMERA
        bool "Stream camera frames over the DataChannel"
        depends on IDF_TARGET_ESP32 || IDF_TARGET_ESP32S3
        default y
        help
            Send JPEG frames of an esp32-camera board over the DataChannel. Without it
            the example only exchanges text messages over the DataChannel.

    choice ESP32_CAMERA_MODEL
        prompt "Camera model"
        depends on EXAMPLE_ENABLE_CAMERA
        default ESP32_EYE
        help
            Select the camera model to use.
        config ESP32_EYE
            bool "ESP32-EYE"
        config ESP32S3_EYE
            bool "ESP32S3-EYE"
        config ESP32_M5STACK_CAMERA_B
            bool "M5STACK-CAMERA-B"
        config ESP32S3_XIAO_SENSE
            bool "ESP32S3-XIAO-SENSE"
    endchoice

    config SIGNALING_URL
        string "Signaling URL"
        default "https://libpeer.com/public/test"
        help
            Enter the URL of the Peer library to use.
    config SIGNALING_TOKEN
        string "Signaling Token"
        default ""
        help
            Enter the token of the Peer library to use.
endmenu
```
